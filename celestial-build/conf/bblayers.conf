## celestial-build/conf/bblayers.conf
```bitbake
# POKY_BBLAYERS_CONF_VERSION is increased each time build/conf/bblayers.conf
# changes incompatibly
POKY_BBLAYERS_CONF_VERSION = "2"

BBPATH = "${TOPDIR}"
BBFILES ?= ""

BBLAYERS ?= " \
  /home/adam/sync-oe/sources/poky/meta \
  /home/adam/sync-oe/sources/poky/meta-poky \
  /home/adam/sync-oe/sources/poky/meta-yocto-bsp \
  "
```

## cytovale-build/conf/bblayers.conf
```bitbake
# LAYER_CONF_VERSION is increased each time build/conf/bbsources.conf
# changes incompatibly
LCONF_VERSION = "7"

BBPATH = "${TOPDIR}"
BBFILES ?= ""

BBLAYERS ?= " \
  ${TOPDIR}/../sources/meta-angstrom \
  ${TOPDIR}/../sources/meta-toradex-nxp \
  ${TOPDIR}/../sources/meta-freescale \
  ${TOPDIR}/../sources/meta-freescale-3rdparty \
  ${TOPDIR}/../sources/meta-toradex-bsp-common \
  ${TOPDIR}/../sources/meta-openembedded/meta-oe \
  ${TOPDIR}/../sources/meta-openembedded/meta-filesystems \
  ${TOPDIR}/../sources/meta-openembedded/meta-gnome \
  ${TOPDIR}/../sources/meta-openembedded/meta-xfce \
  ${TOPDIR}/../sources/meta-openembedded/meta-initramfs \
  ${TOPDIR}/../sources/meta-openembedded/meta-networking \
  ${TOPDIR}/../sources/meta-openembedded/meta-multimedia \
  ${TOPDIR}/../sources/meta-openembedded/meta-python \
  ${TOPDIR}/../sources/meta-lxde \
  ${TOPDIR}/../sources/meta-browser \
  ${TOPDIR}/../sources/meta-qt4 \
  ${TOPDIR}/../sources/meta-qt5 \
  ${TOPDIR}/../sources/meta-qt5-extra \
  ${TOPDIR}/../sources/meta-freescale-distro \
  ${TOPDIR}/../sources/meta-toradex-demos \
  ${TOPDIR}/../sources/openembedded-core/meta \
  ${TOPDIR}/../sources/meta-cytovale \
  ${TOPDIR}/../sources/meta-syncroness \
  /app/sync-oe/cytovale-build/workspace \
  "
```

## sources/meta-cytovale/conf/layer.conf
```bitbake
# We have a conf and classes directory, add to BBPATH
BBPATH .= ":${LAYERDIR}"

# We have recipes-* directories, add to BBFILES
BBFILES += "${LAYERDIR}/recipes-*/*/*.bb \
	${LAYERDIR}/recipes-*/*/*.bbappend"

BBFILE_COLLECTIONS += "cytovale"
BBFILE_PATTERN_cytovale = "^${LAYERDIR}/"
# Any overrides here are top priority
BBFILE_PRIORITY_cytovale = "99"
```
